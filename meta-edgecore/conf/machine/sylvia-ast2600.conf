## meta-edgecore/conf/machine/sylvia-ast2600.conf
```bitbake
#KERNEL_DEVICETREE = "aspeed-bmc-opp-tacoma.dtb"
UBOOT_MACHINE_sylvia-ast2600 = "ast2600_openbmc_defconfig"
UBOOT_DEVICETREE = "ast2600-tacoma"

#UBOOT_MACHINE = "evb-ast2600a1_defconfig"
#UBOOT_DEVICETREE = "ast2600a1-evb"
KMACHINE = "aspeed"
KERNEL_DEVICETREE = "${KMACHINE}-bmc-ec-${MACHINE}.dtb"

#KERNEL_IMAGETYPE = "zImage"

#IMAGE_FSTYPES += "ext4 mmc-ext4-tar"

OBMC_POWER_SUPPLY_INSTANCES = "0 1"

MACHINEOVERRIDES =. "ibm-ac-server:sylvia:"
require conf/machine/include/ast2600.inc
require conf/machine/include/obmc-bsp-common.inc
require conf/machine/include/openpower.inc
require conf/machine/include/p9.inc

SERIAL_CONSOLES = "115200;ttyS4"

MRW_XML = "witherspoon.xml"
PHOSPHOR_MRW_LICENSE = "Apache-2.0"
PHOSPHOR_MRW_LIC_FILES_CHKSUM = "file://LICENSE;md5=e3fc50a88d0a364313df4b21ef20c29e"
PHOSPHOR_MRW_URI = "git://github.com/open-power/witherspoon-xml"
PHOSPHOR_MRW_REV = "c622cb5a5dd3ebc2a4eef558d1b70740f914e6f7"

VIRTUAL-RUNTIME_phosphor-hwmon-config_df-mrw = ""

PREFERRED_PROVIDER_virtual/phosphor-fan-control-fan-config_df-mrw = \
    "phosphor-fan-control-fan-config"
PREFERRED_PROVIDER_virtual/phosphor-fan-presence-config_df-mrw = \
    "phosphor-fan-presence-config"

#FLASH_SIZE = "131072"
#FLASH_SIZE = "65536"
#FLASH_KERNEL_OFFSET = "1024"
#FLASH_ROFS_OFFSET = "10240"
#FLASH_RWFS_OFFSET = "43008"

FLASH_SIZE = "32768" 
FLASH_KERNEL_OFFSET = "1024"
FLASH_ROFS_OFFSET = "10240"
FLASH_RWFS_OFFSET = "30720"
```

## meta-edgecore/meta-as9737-32db/conf/bblayers.conf.sample
```bitbake
# LAYER_CONF_VERSION is increased each time build/conf/bblayers.conf
# changes incompatibly
LCONF_VERSION = "8"

BBPATH = "${TOPDIR}"
BBFILES ?= ""

BBLAYERS ?= " \
  ##OEROOT##/meta \
  ##OEROOT##/meta-openembedded/meta-oe \
  ##OEROOT##/meta-openembedded/meta-networking \
  ##OEROOT##/meta-openembedded/meta-perl \
  ##OEROOT##/meta-openembedded/meta-python \
  ##OEROOT##/meta-phosphor \
  ##OEROOT##/meta-aspeed \
  ##OEROOT##/meta-openpower \
  ##OEROOT##/meta-edgecore \
  ##OEROOT##/meta-edgecore/meta-as9737-32db \
  "
BBLAYERS_NON_REMOVABLE ?= " \
  ##OEROOT##/meta \
  ##OEROOT##/meta-openembedded/meta-oe \
  ##OEROOT##/meta-openembedded/meta-networking \
  ##OEROOT##/meta-openembedded/meta-perl \
  ##OEROOT##/meta-openembedded/meta-python \
  ##OEROOT##/meta-phosphor \
  ##OEROOT##/meta-aspeed \
  ##OEROOT##/meta-openpower \
  ##OEROOT##/meta-edgecore \
  ##OEROOT##/meta-edgecore/meta-as9737-32db \
  "
```

## meta-edgecore/meta-as9737-32db/conf/machine/as9737-32db.conf
```bitbake
UBOOT_MACHINE_as9737-32db = "ast2600_openbmc_defconfig"
UBOOT_DEVICETREE = "ast2600-ec-${MACHINE}"

KMACHINE = "aspeed"
KERNEL_DEVICETREE = "${KMACHINE}-bmc-ec-${MACHINE}.dtb"

OBMC_POWER_SUPPLY_INSTANCES = "0 1"

require conf/machine/include/ast2600.inc
require conf/machine/include/obmc-bsp-common.inc
require conf/machine/include/openpower.inc

SERIAL_CONSOLES = "115200;ttyS4"

PREFERRED_PROVIDER_virtual/obmc-host-ipmi-hw = "phosphor-ipmi-kcs"

FLASH_SIZE = "40960"
FLASH_KERNEL_OFFSET = "1024"
FLASH_ROFS_OFFSET = "10240"
FLASH_RWFS_OFFSET = "38912"
```
